## zephyr/una/boards/una/una_watch/board.yml
```yaml
board:
  name: una_watch
  full_name: UNA Watch
  vendor: una
  socs:
    - name: stm32u5a5xx
```

## zephyr/una/drivers/Kconfig
```kconfig
if DISPLAY
rsource "display/Kconfig"
endif

if DISK_DRIVERS
rsource "disk/Kconfig"
endif

if GNSS
rsource "gnss/Kconfig"
endif
```

## zephyr/una/drivers/disk/Kconfig
```kconfig
config DISK_DRIVER_REGION
	bool "Disk regions"
	default y
	depends on DT_HAS_UNA_DISK_REGION_ENABLED
	help
	  Present sector ranges of a disk as disks of their own.
```

## zephyr/una/drivers/display/Kconfig
```kconfig
config LS012B7DD06A
	bool "Sharp LS012B7DD06A 240x240 64-colour memory LCD (parallel)"
	default y
	depends on DT_HAS_SHARP_LS012B7DD06A_ENABLED
	depends on SOC_SERIES_STM32U5X
	select USE_STM32_HAL_LPTIM
	select USE_STM32_LL_RCC
	select PINCTRL
	help
	  Bit-banged driver for the UNA Watch panel. The STM32U5 clocks the
	  panel's shift registers directly from GPIO and drives its liquid
	  crystal polarity signals (FRP/XFRP) from LPTIM1 and LPTIM3.
```

## zephyr/una/drivers/gnss/Kconfig
```kconfig
config GNSS_AG3335M
	bool "Airoha AG3335M GNSS receiver"
	default y
	depends on DT_HAS_AIROHA_AG3335M_ENABLED
	depends on GNSS_REFERENCE_FRAME_WGS84
	select MODEM_MODULES
	select MODEM_BACKEND_UART
	select MODEM_CHAT
	select GNSS_PARSE
	select GNSS_NMEA0183
	select GNSS_NMEA0183_MATCH
	help
	  The UNA Watch's GNSS receiver: NMEA sentences on a UART, set up with
	  Airoha's PAIR commands as the stock firmware does.

config GNSS_AG3335M_SAT_ARRAY_SIZE
	int "Satellites kept from the GSV sentences"
	default 32
	depends on GNSS_AG3335M && GNSS_SATELLITES
```

## zephyr/una/drivers/sensor/bmi270/Kconfig
```kconfig
# Copyright (c) 2021 Bosch Sensortec GmbH
# Copyright (c) 2022 Nordic Semiconductor ASA
# SPDX-License-Identifier: Apache-2.0

config UNA_BMI270
	bool "BMI270 accelerometer and gyroscope, with its wrist features"
	default y
	depends on DT_HAS_UNA_BMI270_ENABLED
	select I2C
	help
	  Bosch's BMI270 on I2C: acceleration, rotation, and the chip's own
	  step counter, activity, wrist-wear wake-up and motion detection.
	  Made of Zephyr's driver for the part, which has none of the features
	  but any motion.

if UNA_BMI270

config UNA_BMI270_THREAD_PRIORITY
	int "Priority of the thread that handles the chip's interrupts"
	default 8

config UNA_BMI270_THREAD_STACK_SIZE
	int "Stack of the thread that handles the chip's interrupts"
	default 1536
	help
	  Trigger handlers run on it.

config UNA_BMI270_LOW_POWER_MODE
	bool "Power-optimized filters at every rate"
	help
	  The accelerometer and the gyroscope use their power-optimized
	  filters whatever the rate. Otherwise they do so below 100 Hz only,
	  and from there on the ones that perform best.

endif # UNA_BMI270
```

## zephyr/una/drivers/sensor/bmm350/Kconfig
```kconfig
# Copyright (c) 2024 Bosch Sensortec GmbH
# SPDX-License-Identifier: Apache-2.0

config UNA_BMM350
	bool "BMM350 magnetometer"
	default y
	depends on DT_HAS_UNA_BMM350_ENABLED
	select I2C
	help
	  Bosch's BMM350 on I2C, asleep until a rate is asked of it. Made of
	  Zephyr's driver for the part, which turns every I2C bus over to
	  RTIO, leaves the chip measuring, and gives the field in whole
	  microtesla.
```

## zephyr/una/drivers/sensor/pah8316/Kconfig
```kconfig
# Copyright (c) 2026 Albin Stigo
# SPDX-License-Identifier: Apache-2.0

config UNA_PAH8316
	bool "PAH8316 heart-rate sensor"
	default y
	depends on DT_HAS_PIXART_PAH8316_ENABLED
	select I2C
	help
	  PixArt's PAH8316LS optical heart-rate sensor on I2C: the green
	  channels at 20 Hz in batches of a second, and whether there is skin
	  under it. Without supply until a sampling frequency is set. The part
	  has no public datasheet; the driver is written from what PixArt's
	  own library was seen to do on the bus.

if UNA_PAH8316

config UNA_PAH8316_THREAD_PRIORITY
	int "Priority of the thread that reads the sensor"
	default 8

config UNA_PAH8316_THREAD_STACK_SIZE
	int "Stack of the thread that reads the sensor"
	default 1536

endif
```

## zephyr/una/dts/bindings/disk/una,disk-region.yaml
```yaml
description: |
  A contiguous range of sectors of another disk, presented as a disk of its
  own. The UNA Watch's eMMC is divided this way, without a partition table of
  its own: each region starts with an MBR and holds one exFAT volume.

compatible: "una,disk-region"

properties:
  disk-name:
    type: string
    required: true
    description: Name the region is registered under.
  parent-disk:
    type: string
    required: true
    description: Name of the disk the region is part of.
  start-sector:
    type: int
    required: true
  sector-count:
    type: int
    description: Leave out for "to the end of the parent".
  read-only:
    type: boolean
```

## zephyr/una/dts/bindings/display/sharp,ls012b7dd06a.yaml
```yaml
description: |
  Sharp LS012B7DD06A 1.2" 240x240 memory-in-pixel LCD, 2 bits per colour,
  driven directly from STM32U5 GPIO. The six data lines must be pins 0, 8, 2,
  10, 4 and 12 (R1 R2 G1 G2 B1 B2) of one port that has no other outputs,
  because a pair of pixels is written to that port in one store. FRP and XFRP
  come from LPTIM1 and LPTIM3 channel 1, selected by pinctrl-0.

compatible: "sharp,ls012b7dd06a"

include: [display-controller.yaml, pinctrl-device.yaml]

properties:
  vst-gpios:
    type: phandle-array
    required: true
    description: Start signal of the vertical driver (GSP).
  vck-gpios:
    type: phandle-array
    required: true
    description: Shift clock of the vertical driver (GCK).
  enb-gpios:
    type: phandle-array
    required: true
    description: Write enable of the pixel memory (GEN).
  xrst-gpios:
    type: phandle-array
    required: true
    description: Reset of both drivers (INTB).
  hst-gpios:
    type: phandle-array
    required: true
    description: Start signal of the horizontal driver (BSP).
  hck-gpios:
    type: phandle-array
    required: true
    description: Shift clock of the horizontal driver (BCK).
  rgb-gpios:
    type: phandle-array
    required: true
    description: R1, R2, G1, G2, B1, B2 in that order.
  rotated:
    type: boolean
    description: |
      The panel is mounted a quarter turn round; frames are turned on the way
      in so that the application draws upright.
```

## zephyr/una/dts/bindings/gnss/airoha,ag3335m.yaml
```yaml
description: |
  Airoha AG3335M GNSS receiver on a UART, as on the UNA Watch. It is off
  until gnss_ag3335m_power() turns it on.

compatible: "airoha,ag3335m"

include: uart-device.yaml

properties:
  enable-gpios:
    type: phandle-array
    required: true
    description: Powers the chip.
```

## zephyr/una/dts/bindings/sensor/pixart,pah8316.yaml
```yaml
description: |
  PixArt PAH8316LS optical heart-rate sensor on I2C (drivers/sensor/pah8316).

  The chip and its LEDs have no supply until a sampling frequency is set,
  and lose it when that is set to 0.

compatible: "pixart,pah8316"

include: [sensor-device.yaml, i2c-device.yaml]

properties:
  irq-gpios:
    type: phandle-array
    required: true
    description: The chip's interrupt line, which rises and stays up until served.

  enable-gpios:
    type: phandle-array
    description: Switches the chip's supply. Without it the supply is taken to be on.

  led-enable-gpios:
    type: phandle-array
    description: Switches the LEDs' supply. Without it the supply is taken to be on.
```

## zephyr/una/dts/bindings/sensor/una,bmi270.yaml
```yaml
description: |
  Bosch BMI270 accelerometer and gyroscope on I2C, with the chip's features
  for a wrist: step counter, activity, wrist-wear wake-up, any and no
  motion. This tree's driver (drivers/sensor/bmi270, see <una/bmi270.h>),
  made of Zephyr's for "bosch,bmi270".

  The driver uploads 8 kB of configuration when it starts, a fifth of a
  second at 400 kHz. With zephyr,deferred-init that is not spent at boot.

compatible: "una,bmi270"

include: [sensor-device.yaml, i2c-device.yaml]

properties:
  irq-gpios:
    type: phandle-array
    description: |
      The one interrupt line to the host; every interrupt of the chip is put
      on it. Without it there are no triggers.

  int-pin:
    type: int
    default: 1
    enum: [1, 2]
    description: Which of the chip's pins, INT1 or INT2, irq-gpios is wired to.

  axes:
    type: array
    default: [0, 1, 2]
    description: |
      For each axis of the device, x y z, the axis of the chip (0 x, 1 y,
      2 z) that lies along it. The chip's features assume a watch seen from
      the front: x to three o'clock, y to twelve, z out of the dial.

  axes-inverted:
    type: array
    default: [0, 0, 0]
    description: For each axis of the device, 1 when the chip's points the other way.

  wrist-wake-params:
    type: array
    description: |
      WR_WAKEUP_2 to WR_WAKEUP_7: min_angle_focus, min_angle_nonfocus,
      max_tilt_lr, max_tilt_ll, max_tilt_pd, max_tilt_pu, each the cosine or
      sine of an angle times 2048 (datasheet 4.8.6). The chip's own values
      when absent.
```

## zephyr/una/dts/bindings/sensor/una,bmm350.yaml
```yaml
description: |
  Bosch BMM350 magnetometer on I2C. This tree's driver
  (drivers/sensor/bmm350), made of Zephyr's for "bosch,bmm350".

  The chip is suspended, at a few microamps, until a sampling frequency is
  set, and again when that is set to 0. Starting the driver takes a tenth
  of a second: with zephyr,deferred-init that is not spent at boot.

compatible: "una,bmm350"

include: [sensor-device.yaml, i2c-device.yaml]

properties:
  axes:
    type: array
    default: [0, 1, 2]
    description: |
      For each axis of the device, x y z, the axis of the chip (0 x, 1 y,
      2 z) that lies along it. The field is given in the device's frame.

  axes-inverted:
    type: array
    default: [0, 0, 0]
    description: For each axis of the device, 1 when the chip's points the other way.
```
